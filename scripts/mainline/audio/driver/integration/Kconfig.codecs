## scripts/mainline/audio/driver/integration/Kconfig.codecs
```kconfig
config SND_SOC_ES9218_A9
 tristate "Experimental Hisense A9 ESS HiFi DAC"
 depends on I2C && GPIOLIB
 select REGMAP_I2C
 help
   Board-specific control sequence recovered from the stock A9 ES9218/ESS9318
   module. Unvalidated hardware bring-up support; requires opt-in board DT.
```

## scripts/mainline/audio/driver/integration/Kconfig.qcom
```kconfig
config SND_SOC_A9_ES9218
 tristate "Experimental Hisense A9 ESS APR/MI2S sound card"
 depends on QCOM_APR && I2C && GPIOLIB
 select SND_SOC_QDSP6
 select SND_SOC_QCOM_COMMON
 select SND_SOC_ES9218_A9
 help
   Isolated A9 HiFi playback path. The first backend is 48 kHz stereo S32_LE
   using secondary MI2S with 32-bit serial slots. No SoundWire dependency.
```

## scripts/mainline/eink/driver/Kconfig
```kconfig
# SPDX-License-Identifier: GPL-2.0-only
config DRM_A9_EINK
	tristate "Hisense A9 (HLTE556N) E Ink display with in-kernel software TCON"
	depends on DRM && OF && ARM64 && MMU
	depends on REGULATOR_FP9929A && IIO
	# msm's fbdev client would scan console contents out to the E Ink transport
	depends on !DRM_FBDEV_EMULATION
	select DRM_CLIENT
	select DRM_KMS_HELPER
	select DRM_GEM_SHMEM_HELPER
	select FW_LOADER
	select CRYPTO_LIB_SHA256
	help
	  An 824x1648 KMS device for the Hisense A9 E Ink panel. The kernel
	  runs the software TCON (a port of the stock composer's frame
	  generation) and scans the 448x829 drive frames out through the msm
	  DSI output and the TC358767 bridge. Waveform tables are loaded with
	  request_firmware from hisense/a9-waveform.bin, extracted by the
	  user from their own composer binary. Sends nothing to the panel
	  unless a9_eink.enable=1.

config DRM_A9_EINK_KUNIT_TEST
	bool "KUnit tests for the a9_eink KMS state" if !KUNIT_ALL_TESTS
	depends on DRM_A9_EINK=y && KUNIT=y
	select DRM_KUNIT_TEST_HELPERS
	default KUNIT_ALL_TESTS
	help
	  Atomic-check tests of the fixed-mode CRTC (ACTIVE-only commits,
	  disable commits keeping the mode, framebuffer sizes). No hardware.
```

## scripts/mainline/frontlight/driver/Kconfig
```kconfig
# SPDX-License-Identifier: GPL-2.0-only
config LEDS_A9_FRONTLIGHT
	tristate "Hisense A9 AW99703/KTD3137 frontlight LEDs"
	depends on I2C && OF && GPIOLIB
	depends on LEDS_CLASS
	help
	  Four raw 11-bit frontlight LEDs using the Hisense A9 stock electrical
	  profiles. Per-chip brightness gains belong in userspace, not here.
	  If built as a module it is named a9-frontlight.
```
